## boards/arm/atsamd21g_r3_breakout/Kconfig.board
```kconfig
config BOARD_ATSAMD21G_R3_BREAKOUT
	bool "ATSAMD21G R3 Breakout"
	depends on SOC_PART_NUMBER_SAMD21G18A
```

## boards/arm/atsamd21g_r3_breakout/Kconfig.defconfig
```kconfig
if BOARD_ATSAMD21G_R3_BREAKOUT

config BOARD
	default "atsamd21g_r3_breakout"

endif # BOARD_ATSAMD21G_R3_BREAKOUT
```

## boards/arm/atsamd21g_r3_breakout/atsamd21g_r3_breakout_defconfig
```kconfig
CONFIG_SOC_SERIES_SAMD21=y
CONFIG_SOC_PART_NUMBER_SAMD21G18A=y
CONFIG_BOARD_ATSAMD21G_R3_BREAKOUT=y

CONFIG_CORTEX_M_SYSTICK=y
CONFIG_SOC_ATMEL_SAMD_XOSC32K=y
CONFIG_SOC_ATMEL_SAMD_XOSC32K_AS_MAIN=y
```
